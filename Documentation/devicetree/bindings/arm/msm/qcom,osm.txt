## Documentation/devicetree/bindings/arm/msm/qcom,osm.txt
```
Qualcomm Technologies, Inc. OSM Bindings

Operating State Manager (OSM) is a hardware engine used by some Qualcomm
Technologies, Inc. (QTI) SoCs to manage frequency and voltage scaling
in hardware. OSM is capable of controlling frequency and voltage requests
for multiple clusters via the existence of multiple OSM domains.

Properties:
- compatible
	Usage:      required
	Value type: <string>
	Definition: must be "qcom,clk-cpu-osm" or "qcom,clk-cpu-osm-sdmshrike"
			or "qcom,clk-cpu-osm-sm6150" or
			"qcom,clk-cpu-osm-sdmmagpie" or
			"qcom,clk-cpu-osm-trinket" or
			"qcom,clk-cpu-osm-atoll".

- reg
	Usage:      required
	Value type: <prop-encoded-array>
	Definition: Addresses and sizes for the memory of the OSM controller.

- reg-names
	Usage:      required
	Value type: <stringlist>
	Definition: Address names. Must be "osm_l3_base", "osm_pwrcl_base",
		    and "osm_perfcl_base". Can optionally have
		    "osm_perfpcl_base".
		    Must be specified in the same order as the corresponding
		    addresses are specified in the reg property.

- l3-devs
	Usage: optional
	Value type: <phandle>
	Definition: List of phandles to devices that the OPP tables with the L3
		    frequency and voltage mappings are loaded for.

- qcom,cpufreq-table-XX
	Usage: optional
	Value type: <u32>
	Definition: List of frequencies (in kHz) to expose in CPU XX's cpufreq table.
		    All frequencies present in hardware will be exposed if this list
		    is not present.

Example:
	clock_cpucc: qcom,cpucc {
		compatible = "qcom,clk-cpu-osm";
		reg = <0x18321000 0x1400>,
			<0x18323000 0x1400>,
			<0x18325800 0x1400>,
			<0x18327800 0x1400>;
		reg-names = "osm_l3_base", "osm_pwrcl_base",
			"osm_perfcl_base", "osm_perfpcl_base";

		l3-devs = <&phandle0 &phandle1 &phandle2>;

		#clock-cells = <1>;
		qcom,cpufreq-table-0 =
			< 300000>,
			< 403200>,
			< 480000>,
			< 576000>,
			< 672000>,
			< 768000>,
			< 864000>,
			< 979200>,
			<1075200>,
			<1171200>,
			<1267200>;

		qcom,cpufreq-table-4 =
			< 576000>,
			< 672000>,
			< 768000>,
			< 864000>,
			< 960000>,
			<1056000>,
			<1152000>,
			<1248000>,
			<1344000>,
			<1420800>,
			<1497600>,
			<1593600>,
			<1689600>,
			<1785600>,
			<1862400>,
			<1939200>,
			<2016000>;

		qcom,cpufreq-table-7 =
			< 691200>,
			< 768000>,
			< 864000>,
			< 940800>,
			<1017600>,
			<1113600>,
			<1190400>,
			<1286400>,
			<1363200>,
			<1459200>,
			<1536000>,
			<1632000>,
			<1728000>,
			<1824000>,
			<1900800>,
			<1977600>,
			<2054400>;
	};

- qcom,cpu-voltage-table-XX
	Usage: optional
	Value type: <u32>
	Definition: List of voltages (in mV) to override the hardware OSM LUT
		    for cluster XX (0 = little, 1 = big, 2 = prime).
		    The number of entries in this list must exactly match the
		    number of hardware frequencies for the given cluster.

Example:
		qcom,cpu-voltage-table-0 =
			< 600 >, /* 300000 kHz */
			< 600 >, /* 403200 kHz */
			< 600 >, /* 499200 kHz */
			< 600 >, /* 576000 kHz */
			< 600 >, /* 672000 kHz */
			< 620 >, /* 768000 kHz */
			< 632 >, /* 844800 kHz */
			< 648 >, /* 940800 kHz */
			< 668 >, /* 1036800 kHz */
			< 680 >, /* 1113600 kHz */
			< 700 >, /* 1209600 kHz */
			< 720 >, /* 1305600 kHz */
			< 736 >, /* 1382400 kHz */
			< 756 >, /* 1478400 kHz */
			< 756 >, /* 1555200 kHz */
			< 776 >, /* 1632000 kHz */
			< 800 >, /* 1708800 kHz */
			< 816 >; /* 1785600 kHz */

		qcom,cpu-voltage-table-1 =
			< 756 >, /* 710400 kHz */
			< 756 >, /* 825600 kHz */
			< 756 >, /* 940800 kHz */
			< 756 >, /* 1056000 kHz */
			< 756 >, /* 1171200 kHz */
			< 756 >, /* 1286400 kHz */
			< 756 >, /* 1401600 kHz */
			< 776 >, /* 1497600 kHz */
			< 804 >, /* 1612800 kHz */
			< 824 >, /* 1708800 kHz */
			< 844 >, /* 1804800 kHz */
			< 860 >, /* 1920000 kHz */
			< 888 >, /* 2016000 kHz */
			< 920 >, /* 2131200 kHz */
			< 944 >, /* 2227200 kHz */
			< 972 >, /* 2323200 kHz */
			< 1000 >; /* 2419200 kHz */

		qcom,cpu-voltage-table-2 =
			< 756 >, /* 825600 kHz */
			< 756 >, /* 940800 kHz */
			< 756 >, /* 1056000 kHz */
			< 756 >, /* 1171200 kHz */
			< 756 >, /* 1286400 kHz */
			< 756 >, /* 1401600 kHz */
			< 756 >, /* 1497600 kHz */
			< 756 >, /* 1612800 kHz */
			< 756 >, /* 1708800 kHz */
			< 772 >, /* 1804800 kHz */
			< 792 >, /* 1920000 kHz */
			< 808 >, /* 2016000 kHz */
			< 828 >, /* 2131200 kHz */
			< 840 >, /* 2227200 kHz */
			< 860 >, /* 2323200 kHz */
			< 884 >, /* 2419200 kHz */
			< 912 >, /* 2534400 kHz */
			< 936 >, /* 2649600 kHz */
			< 960 >, /* 2745600 kHz */
			< 984 >; /* 2841600 kHz */
```

## drivers/block/zram/Kconfig
```kconfig
# SPDX-License-Identifier: GPL-2.0
config ZRAM
	tristate "Compressed RAM block device support"
	depends on BLOCK && SYSFS && ZSMALLOC && CRYPTO
	select CRYPTO_LZO
	select CRYPTO_ZSTD
	default n
	help
	  Creates virtual block devices called /dev/zramX (X = 0, 1, ...).
	  Pages written to these disks are compressed and stored in memory
	  itself. These disks allow very fast I/O and compression provides
	  good amounts of memory savings.

	  It has several use cases, for example: /tmp storage, use as swap
	  disks and maybe many more.

	  See Documentation/blockdev/zram.txt for more information.

choice
	prompt "Default compressor"
	default ZRAM_DEF_COMP_ZSTD
	depends on ZRAM
	help
	  Default compressor to use for zram devices. This can still be
	  overridden at runtime via /sys/block/zramX/comp_algorithm before
	  the device is initialised.

	  zstd generally offers a better compression ratio than lzo/lz4 at
	  a still-reasonable speed, which makes it a good default for the
	  swap use case.

	config ZRAM_DEF_COMP_LZO
		bool "lzo"
		select CRYPTO_LZO

	config ZRAM_DEF_COMP_LZ4
		bool "lz4"
		select CRYPTO_LZ4

	config ZRAM_DEF_COMP_LZ4HC
		bool "lz4hc"
		select CRYPTO_LZ4HC

	config ZRAM_DEF_COMP_DEFLATE
		bool "deflate"
		select CRYPTO_DEFLATE

	config ZRAM_DEF_COMP_842
		bool "842"
		select CRYPTO_842

	config ZRAM_DEF_COMP_ZSTD
		bool "zstd"
		select CRYPTO_ZSTD
endchoice

config ZRAM_DEF_COMP
	string
	default "lzo" if ZRAM_DEF_COMP_LZO
	default "lz4" if ZRAM_DEF_COMP_LZ4
	default "lz4hc" if ZRAM_DEF_COMP_LZ4HC
	default "deflate" if ZRAM_DEF_COMP_DEFLATE
	default "842" if ZRAM_DEF_COMP_842
	default "zstd" if ZRAM_DEF_COMP_ZSTD
	default "lzo"

config ZRAM_DEDUP
	bool "Deduplication support for ZRAM data"
	depends on ZRAM
	select XXHASH
	default n
	help
	  Deduplicate ZRAM data to reduce amount of memory consumption.
	  Advantage largely depends on the workload. In some cases, this
          option reduces memory usage to the half. However, if there is no
	  duplicated data, the amount of memory consumption would be
	  increased due to additional metadata usage. And, there is
	  computation time trade-off. Please check the benefit before
	  enabling this option. Experiment shows the positive effect when
	  the zram is used as blockdev and is used to store build output.

config ZRAM_WRITEBACK
       bool "Write back incompressible or idle page to backing device"
       depends on ZRAM
       default n
       help
	 With incompressible page, there is no memory saving to keep it
	 in memory. Instead, write it out to backing device.
	 For this feature, admin should set up backing device via
	 /sys/block/zramX/backing_dev.

	 With /sys/block/zramX/{idle,writeback}, application could ask
	 idle page's writeback to the backing device to save in memory.

	 See Documentation/blockdev/zram.txt for more information.

config ZRAM_MEMORY_TRACKING
	bool "Track zRam block status"
	depends on ZRAM && DEBUG_FS
	help
	  With this feature, admin can track the state of allocated blocks
	  of zRAM. Admin could see the information via
	  /sys/kernel/debug/zram/zramX/block_state.

	  See Documentation/blockdev/zram.txt for more information.

config ZRAM_ENTROPY
	bool "Use entropy optimization for zram"
	depends on ZRAM
	help
	  With this feature, entropy will be calculated for each page.
	  Pages above ZRAM_ENTROPY_THRESHOLD entropy will be
	  stored uncompressed. Use this feature if you need a performance
	  boost and a small loss in compression.

config ZRAM_ENTROPY_THRESHOLD
	int
	depends on ZRAM && ZRAM_ENTROPY
	default 100000
	help
	  Pages with entropy above ZRAM_ENTROPY_THRESHOLD will be stored
	  uncompressed. The default value was chosen as a reasonable balance 
	  between compression ratio and performance.
```
